## glove80/config/west.yml
```yaml
manifest:
  remotes:
    - name: moergo-sc
      url-base: https://github.com/moergo-sc
    - name: bryanforbes
      url-base: https://github.com/bryanforbes
  projects:
    # - name: zmk
    #   remote: moergo-sc
    #   #revision: main
    #   revision: zephyr-3-2-20230730 # PR19
    #   import: app/west.yml
    - name: zmk
      remote: bryanforbes
      #revision: main
      revision: mouse-3.2
      import: app/west.yml
  self:
    path: config
```

## leeloo-micro/config/west.yml
```yaml
manifest:
  remotes:
    - name: zmkfirmware
      url-base: https://github.com/zmkfirmware

    # My fork with some additions like urob's mouse keys.
    - name: jasonish
      url-base: git@github.com:jasonish
  projects:
    # - name: zmk
    #   remote: zmkfirmware
    #   revision: main
    #   import: app/west.yml
    - name: zmk
      remote: jasonish
      revision: picks/v1
      import: app/west.yml
  self:
    path: config
```
